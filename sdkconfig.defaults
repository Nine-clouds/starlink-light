## sdkconfig.defaults
```kconfig
CONFIG_ESP_HTTPS_OTA_ALLOW_HTTP=y
CONFIG_LWIP_DHCPS_ADD_DNS=y
CONFIG_LWIP_MAX_SOCKETS=16
CONFIG_PARTITION_TABLE_CUSTOM=y
CONFIG_PARTITION_TABLE_CUSTOM_FILENAME="partitions.csv"
CONFIG_PARTITION_TABLE_FILENAME="partitions.csv"
CONFIG_ESPTOOLPY_FLASHSIZE_4MB=y
```
